## drivers/input/touchscreen/mediatek/Kconfig
```kconfig
#
# Touchscreen driver configuration
#
menuconfig INPUT_TOUCHSCREEN
	bool "Touchscreens"
	help
	  Say Y here, and a list of supported touchscreens will be displayed.
	  This option doesn't affect the kernel.

	  If unsure, say Y.

if INPUT_TOUCHSCREEN

config TOUCHSCREEN_MTK
	bool "MediaTek Touch Panel Driver"
	help
	  Say Y here if you have MediaTek touch panel.

	  If unsure, say N.

	  To compile this dirver as a module, choose M here: the
	  module will be called.

config TOUCHSCREEN_PHYSICAL_ROTATION_WITH_LCM
	bool "MediaTek Touch Panel Rotation With LCM"
	default y
	help
	  Say N here if touch panel is not physical rotated as LCM does.
	  Physically rotated means that this driver will map
	  the reported coordination to diagonal position.

	  If unsure, say Y.
config TOUCHSCREEN_MTK_SOLOMON
	bool "SOLOMON for Mediatek package"
	default n
	help
	  Say Y here if you have SOLOMON touch panel.

	  If unsure, say N.

	  To compile this dirver as a module, choose M here: the
	  module will be called.


config TOUCHSCREEN_MTK_FOCALTECH_TS
	bool "FOCALTECH_TS for Mediatek package"
	default n
	help
	  Say Y here if you have focaltech_touch touch panel.

	  If unsure, say N.

	  To compile this dirver as a module, choose M here: the
	  module will be called.

source "drivers/input/touchscreen/mediatek/focaltech_touch/Kconfig"

config TOUCHSCREEN_HIMAX_CHIPSET
	bool "hxchipset for Mediatek package"
	default n
	help
	  Say Y here if you have hxchipset touch panel.

	  If unsure, say N.

	  To compile this dirver as a module, choose M here: the
	  module will be called.

source "drivers/input/touchscreen/mediatek/hxchipset/Kconfig"

config TOUCHSCREEN_MTK_GT1151
	bool "GT1151 for Mediatek package"
	default n
	help
	  Say Y here if you have GT1151 touch panel.

	  If unsure, say N.

	  To compile this dirver as a module, choose M here: the
	  module will be called.

source "drivers/input/touchscreen/mediatek/GT1151/Kconfig"

config TOUCHSCREEN_MTK_GSLX680
	bool "gslX680 for Mediatek package"
	help
	  Say Y here if you have gslX680 touch panel.

	  If unsure, say N.

	  you can config it if you want to use MTK9XX_LM for
	  touch panel.

config TOUCHSCREEN_MTK_NT36xxx
	bool "NT36xxx for Mediatek package"
	default n
	help
	  Say Y here if you have NT36xxx touch panel.

	  If unsure, say N.

	  To compile this dirver as a module, choose M here: the
	  module will be called.

source "drivers/input/touchscreen/mediatek/NT36xxx/Kconfig"

config TOUCHSCREEN_MTK_GT9XX_LM
	bool "GT9XX_LM for Mediatek package"
	help
	  Say Y here if you have GT9XX_LM touch panel.

	  If unsure, say N.

	  you can config it if you want to use MTK9XX_LM for
	  touch panel.

source "drivers/input/touchscreen/mediatek/GT9XX_LM/Kconfig"

config TOUCHSCREEN_FT5X26
	bool "FT5X26 for Mediatek package"
	help
	  Say Y here if you have FT5X26 touch panel.

	  If unsure, say N.

	  To compile this dirver as a module, choose M here: the
	  module will be called.

config TOUCHSCREEN_FT5X26_WUXGA
	bool "FT5X26 WUXGA for Mediatek package"
	help
	  Say Y here if you have FT5X26 touch panel.

	  If unsure, say N.

	  To compile this dirver as a module, choose M here: the
	  module will be called.

source "drivers/input/touchscreen/mediatek/FT5X26/Kconfig"

config TOUCHSCREEN_MTK_GT5688
	bool "GT1151 for Mediatek package"
	help
	  Say Y here if you have GT5688 touch panel.

	  If unsure, say N.

	  To compile this dirver as a module, choose M here: the
	  module will be called.

source "drivers/input/touchscreen/mediatek/GT5688/Kconfig"
source "drivers/input/touchscreen/mediatek/hxchipset/Kconfig"

config TOUCHSCREEN_MTK_GT911
	bool "GT911 for Mediatek package"
	help
	  Say Y here if you have GT911 touch panel.

	  If unsure, say N.
	  this is a GT911 touch driver config, you can use it
	  if you want.

source "drivers/input/touchscreen/mediatek/GT911/Kconfig"

config TOUCHSCREEN_MTK_FOCALTECH_FHD
	bool "Focaltech FHD Touchscreen"
	depends on I2C
	help
	  Say Y here if you have Focaltech touch panel.
	  If unsure, say N.

config TOUCHSCREEN_MTK_GSL1691
	bool "GSL1691 for Mediatek package"
	default n
	help
	  Say Y here if you have GSL1691 touch panel.

	  If unsure, say N.

config TOUCHSCREEN_MTK_FT8006U
	bool "FT8006U for Mediatek package"
	default n
	help
	  Say Y here if you have FT8006U touch panel.

	  If unsure, say N.

source "drivers/input/touchscreen/mediatek/FT8006U/Kconfig"

config TOUCHSCREEN_MTK_FT8719
	bool "FT8719 for Mediatek package"
	default n
	help
	  Say Y here if you have FT8719 touch panel.

	  If unsure, say N.

config TOUCHSCREEN_MTK_GT1XX
	bool "GT1XX for Mediatek package"
	default n
	help
	  Say Y here if you have GT1XX touch panel.

	  If unsure, say N.

source "drivers/input/touchscreen/mediatek/GT1XX/Kconfig"

config TOUCHSCREEN_CHIPONE
	tristate "Chipone TDDI touchscreen for Mediatek package"
	depends on I2C
	default n
	help
	  Say y here if you have chipone TDDI touch panel.
		
	  If unsure, say N.

	  To compile this driver as a module, choose M here: the
	  module will be called chipone-tddi.

config TOUCHSCREEN_MTK_FOCALTECH_MULTITYPE
	bool "focaltech multiType for Mediatek package"
	default n
	help
	  Say Y here if you have focaltech multiType touch panel.

	  If unsure, say N.

source "drivers/input/touchscreen/mediatek/focaltech_multiType/Kconfig"

config TOUCHSCREEN_MTK_FOCALTECH_TS
    bool "Focaltech Ts for Mediatek"
    default n
    help
      Say Y here if you have Focaltech touch panel.
      If unsure, say N.

source "drivers/input/touchscreen/mediatek/focaltech_touch/Kconfig"

config TOUCHSCREEN_MTK_FT8719_I2C
	bool "ft8719_i2c for Mediatek package"
	default n
	help
	  Say Y here if you have focaltech multiType touch panel.

	  If unsure, say N.

source "drivers/input/touchscreen/mediatek/ft8719_i2c/Kconfig"

config TOUCHSCREEN_HIMAX_HX83112
	bool "HX83112 for Mediatek package"
	default n
	help
	  Say Y here if you have HX83112 touch panel.

	  If unsure, say N.

	  To compile this dirver as a module, choose M here: the
	  module will be called.

source "drivers/input/touchscreen/mediatek/hx83112/Kconfig"

config TOUCHSCREEN_MTK_ILITEK
	bool "ILITEK for Mediatek package"
	default n
	help
	  Say Y here if you have ILITEK touch panel.

	  If unsure, say N.

	  To compile this dirver as a module, choose M here: the
	  module will be called.

config TOUCHSCREEN_MTK_MSG22XX
	bool "MSG22XX for Mediatek package"
	default n
	help
	  Say Y here if you have MSG22XX touch panel.

	  If unsure, say N.

	  To compile this dirver as a module, choose M here: the
	  module will be called.

config TOUCHSCREEN_MTK_PARADE
	bool "PARADE for Mediatek package"
	default n
	help
	  Say Y here if you have PARADE touch panel.

	  If unsure, say N.

	  To compile this dirver as a module, choose M here: the
	  module will be called.

config CUSTOM_KERNEL_TOUCHPANEL
	string "CUSTOM_KERNEL_TOUCHPANEL"
	help
	  To choose kernel TOUCHPANEL driver name

config VANZO_TOUCHPANEL_GESTURES_SUPPORT
	bool "VANZO_TOUCHPANEL_GESTURES_SUPPORT"
	default n
	help
	  This option is used to enable 'SmwartWake' kernel support

config VANZO_FTS_CHIP_TYPE_FT6336U
	string "VANZO_FTS_CHIP_TYPE_FT6336U"
	help
	  To choose kernel if FT6336U chip variant is in use

endif
```
